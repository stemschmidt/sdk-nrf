## samples/enhanced_peripheral/Kconfig
```kconfig
# Config options for PPI trace sample
#
# Copyright (c) 2019 Nordic Semiconductor ASA
#
# SPDX-License-Identifier: LicenseRef-BSD-5-Clause-Nordic
#

mainmenu "Enhanced peripheral sample"

source "Kconfig.zephyr"
```

## samples/enhanced_peripheral/sample.yaml
```yaml
sample:
  description: Sample showing enhanced peripherals
  name: Enhanced Peripheral Sample
tests:
  samples.enhanced_peripheral:
    build_only: true
    build_on_all: true
    platform_whitelist: nrf52dk_nrf52832 nrf52840dk_nrf52840 nrf9160dk_nrf9160
    tags: ci_build
```
